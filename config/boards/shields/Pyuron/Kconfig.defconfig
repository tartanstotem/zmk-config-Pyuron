## config/boards/shields/Pyuron/Kconfig.defconfig
```kconfig
if SHIELD_PYURON_D

config ZMK_KEYBOARD_NAME
    default "TOTEM"

config ZMK_SPLIT_ROLE_CENTRAL
    default y

config ZMK_USB
    default y

config ZMK_SPLIT
    default y

config ZMK_BLE
    default y

config ZMK_POINTING
    default y

endif

if SHIELD_PYURON_R

config ZMK_KEYBOARD_NAME
    default "Pyuron_R"

config ZMK_SPLIT
    default y
    
config ZMK_POINTING
    default y

config PAW3222
    default y

config ZMK_BLE
    default y

endif

if SHIELD_PYURON_L

config ZMK_KEYBOARD_NAME
    default "Pyuron_L"

config ZMK_SPLIT
    default y
    
config ZMK_POINTING
    default y

config PAW3222
    default y

config ZMK_BLE
    default y

endif
```

## config/west.yml
```yaml
manifest:
  remotes:
    - name: zmkfirmware 
      url-base: https://github.com/zmkfirmware
    - name: MeowCatpawkittie
      url-base: https://github.com/MeowCatpawkittie
    - name: caksoylar
      url-base: https://github.com/caksoylar  
    - name: sekigon-gonnoc
      url-base: https://github.com/sekigon-gonnoc
    - name: carrefinho
      url-base: https://github.com/carrefinho
    - name: tartanstotem
      url-base: https://github.com/tartanstotem
  projects:
    - name: zmk
      remote: zmkfirmware
      revision: main
      import: app/west.yml
    - name: zmk-driver-paw3222
      remote: sekigon-gonnoc
      revision: main
    - name: zmk-rgbled-widget
      remote: caksoylar
      revision: main
    - name: prospector-zmk-module
      remote: tartanstotem
      revision: feat/new-status-screens
  self:
    path: config
```
